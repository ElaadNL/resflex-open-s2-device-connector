## examples/basic/sdkconfig.defaults
```kconfig
# SPDX-FileCopyrightText: ElaadNL
#
# SPDX-License-Identifier: Apache-2.0

CONFIG_ESP_MAIN_TASK_STACK_SIZE=12288
CONFIG_MAIN_TASK_STACK_SIZE=12288
CONFIG_PARTITION_TABLE_SINGLE_APP_LARGE=y

CONFIG_MBEDTLS_DEBUG=n
CONFIG_MBEDTLS_CERTIFICATE_BUNDLE=y
CONFIG_MBEDTLS_CERTIFICATE_BUNDLE_DEFAULT_FULL=y
```
